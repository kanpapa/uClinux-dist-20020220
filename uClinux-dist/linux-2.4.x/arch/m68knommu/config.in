## uClinux-dist/linux-2.4.x/arch/m68knommu/config.in
```kconfig
#############################################################################
#
# For a description of the syntax of this configuration file,
# see Documentation/kbuild/config-language.txt.
#
# based mainly on the arch/i386/config.in and bit of the 2.0, m68knommu
# config.in
#
#############################################################################

mainmenu_name 'uClinux/68k (w/o MMU) Kernel Configuration'

define_bool CONFIG_UCLINUX y
define_bool CONFIG_UID16 y
define_bool CONFIG_RWSEM_GENERIC_SPINLOCK y
define_bool CONFIG_RWSEM_XCHGADD_ALGORITHM n

#############################################################################

mainmenu_option next_comment
comment 'Code maturity level options'
bool 'Prompt for development and/or incomplete code/drivers' CONFIG_EXPERIMENTAL
endmenu

#############################################################################

mainmenu_option next_comment
comment 'Loadable module support'
bool 'Enable loadable module support' CONFIG_MODULES
if [ "$CONFIG_MODULES" = "y" ]; then
   bool '  Set version information on all module symbols' CONFIG_MODVERSIONS
   bool '  Kernel module loader' CONFIG_KMOD
fi
endmenu

#############################################################################

mainmenu_option next_comment
comment 'Processor type and features'

choice 'CPU' \
	"MC68000	CONFIG_M68000 \
	 MC68EN302	CONFIG_M68EN302 \
	 MC68328	CONFIG_M68328 \
         MC68EZ328	CONFIG_M68EZ328 \
	 MC68VZ328	CONFIG_M68VZ328 \
	 MC68332	CONFIG_M68332 \
	 MC68360	CONFIG_M68360 \
	 MCF5204	CONFIG_M5204 \
	 MCF5206	CONFIG_M5206 \
         MCF5206e	CONFIG_M5206e \
	 MCF5272	CONFIG_M5272 \
         MCF5307	CONFIG_M5307 \
	 MCF5407	CONFIG_M5407" M68EZ328

comment 'Platform'

if [ "$CONFIG_M68328" = "y" ]; then
	bool 'Pilot 1000/5000, PalmPilot Personal/Pro, or PalmIII support' CONFIG_PILOT
	if [ "$CONFIG_PILOT" = "y" ]; then
		bool '(X)Copilot support' CONFIG_XCOPILOT_BUGS
bool 'Compile kernel as ELF - if your GCC is ELF-GCC' CONFIG_KERNEL_ELF
		bool 'Display memory usage on Pilot screen' CONFIG_PILOT_MEMORY_DISPLAY
		bool 'Pilot console' CONFIG_PILOT_CONSOLE
	fi
fi

if [ "$CONFIG_M68EZ328" = "y" ]; then
	bool 'Motorola M68EZ328ADS Dev. Board support' CONFIG_M68EZ328ADS
	bool 'ALMA Electronics board support' CONFIG_ALMA_ANS
	bool 'uCsimm module support' CONFIG_UCSIMM
	bool 'PalmV support' CONFIG_PILOT
fi

if [ "$CONFIG_M68VZ328" = "y" ]; then
	bool 'uCdimm module support' CONFIG_UCDIMM
	bool 'Dragon Engine II board support' CONFIG_DRAGEN2
	if [ "$CONFIG_DRAGEN2" = "y" ]; then
		bool 'Read ETH address from EEPROM' CONFIG_HWADDR_FROMEEPROM
		if [ "$CONFIG_HWADDR_FROMEEPROM" = "y" ]; then
			int 'Offset from start of EEPROM' CONFIG_HWADDR_OFFSET 2
		fi
	fi
fi

if [ "$CONFIG_M68EN302" = "y" ]; then
	bool 'Aplio/Pro or Aplio/Entrecote support' CONFIG_APLIO
	if [ "$CONFIG_APLIO" = "y" ]; then
		bool 'Aplio Pro' CONFIG_APLIO_PRO
		bool 'Aplio Entrecote' CONFIG_APLIO_ENTRECOTE
	fi
fi

if [ "$CONFIG_M68332" = "y" ]; then
	bool 'SHGLCore support' CONFIG_SHGLCORE
	if [ "$CONFIG_SHGLCORE" = "y" ]; then
		bool '2Meg SHGLCore' CONFIG_SHGLCORE_2MEG
	fi
fi

if [ "$CONFIG_M5204" = "y" ]; then
	define_bool CONFIG_COLDFIRE y
fi

if [ "$CONFIG_M5206" = "y" ]; then
	define_bool CONFIG_COLDFIRE y
	bool 'Arnewsh 5206 board support' CONFIG_ARNEWSH
fi

if [ "$CONFIG_M5206e" = "y" ]; then
	define_bool CONFIG_COLDFIRE y
	bool 'Motorola M5206eC3 (Cadre-III) board support' CONFIG_CADRE3
	bool 'Motorola eLITE-5206e board support' CONFIG_ELITE
	if [ "$CONFIG_ELITE" = "y" ]; then
		bool '    SRAM only eLITE-5206e support' CONFIG_SMALL
	fi
	bool 'SnapGear/SecureEdge/NETtel board support' CONFIG_NETtel
	bool 'Telos Omnia ToolVox board support' CONFIG_TELOS
        bool 'Netburner CFV2-40 board support' CONFIG_CFV240
fi

if [ "$CONFIG_M5272" = "y" ]; then
	define_bool CONFIG_COLDFIRE y
	bool 'Motorola M5272C3 board support' CONFIG_MOTOROLA
	bool 'SnapGear/SecureEdge/NETtel board support' CONFIG_NETtel
	dep_bool '  Reset switch support' CONFIG_RESETSWITCH $CONFIG_NETtel
	bool 'Marconi/NAP board support' CONFIG_MARCONINAP
	bool 'ROMFS image not RAM resident' CONFIG_ROMFS_FROM_ROM
fi

if [ "$CONFIG_M5307" = "y" ]; then
	define_bool CONFIG_COLDFIRE y
	bool 'Arnewsh 5307 board support' CONFIG_ARNEWSH
	bool 'SecureEdge/NETtel board support' CONFIG_NETtel
	bool 'eLIA board support' CONFIG_eLIA
	bool 'DISKtel board support' CONFIG_DISKtel
	bool 'SnapGear router board support' CONFIG_SNAPGEAR
	bool 'SecureEdge MP3 board support' CONFIG_SECUREEDGEMP3
	bool 'Motorola M5307C3 (Cadre-III) board support' CONFIG_CADRE3
	bool 'Feith CLEOPATRA board support' CONFIG_CLEOPATRA
	bool 'Old mask (broken watchdog timer)' CONFIG_OLDMASK
fi

if [ "$CONFIG_M5407" = "y" ]; then
	define_bool CONFIG_COLDFIRE y
	bool 'Motorola M5407C3 board support' CONFIG_MOTOROLA
	bool 'Feith CLEOPATRA board support' CONFIG_CLEOPATRA
fi

if [ "$CONFIG_M68360" = "y" ]; then
   define_bool CONFIG_360QUICC y
   bool 'Lineo uCquicc board support' CONFIG_UCQUICC
fi

if [ "$CONFIG_360QUICC" = "y" ]; then
   bool 'Support UART on MC68360 SMC' CONFIG_M68360_SMC_UART
   bool 'Support UART on MC68360 SCC' CONFIG_M68360_SCC_UART
   if [ "$CONFIG_M68360_SMC_UART" = "y" -o "$CONFIG_M68360_SCC_UART" = "y" ]; then
       define_bool CONFIG_M68360_UART y
   fi
fi

if [ "$CONFIG_UCSIMM" = "y" -o "$CONFIG_UCDIMM" = "y" -o "$CONFIG_DRAGEN2" = "y" ]; then
   bool '  Initialize LCD' CONFIG_INIT_LCD
   int '  Memory reservation (MB)' CONFIG_MEMORY_RESERVE 0
fi

choice 'CPU CLOCK Frequency' \
	" AUTO	CONFIG_CLOCK_AUTO \
	 16MHz	CONFIG_CLOCK_16MHz \
	 20MHz	CONFIG_CLOCK_20MHz \
	 25MHz	CONFIG_CLOCK_25MHz \
	 33MHz	CONFIG_CLOCK_33MHz \
	 40MHz	CONFIG_CLOCK_40MHz \
	 45MHz	CONFIG_CLOCK_45MHz \
	 50MHz	CONFIG_CLOCK_50MHz \
	 54MHz	CONFIG_CLOCK_54MHz \
	 60MHz	CONFIG_CLOCK_60MHz \
	 66MHz	CONFIG_CLOCK_66MHz" AUTO

choice 'RAM size' \
	"AUTO	CONFIG_RAMAUTO \
	  4MB	CONFIG_RAM4MB \
	  8MB	CONFIG_RAM8MB \
	 16MB	CONFIG_RAM16MB \
	 32MB	CONFIG_RAM32MB" AUTO
choice 'RAM bit width' \
	" AUTO	CONFIG_AUTOBIT \
	  8bit	CONFIG_RAM8BIT \
	 16bit	CONFIG_RAM16BIT \
	 32bit	CONFIG_RAM32bit" AUTO

choice 'FLASH type' \
	"NONE	CONFIG_NOFLASH \
	 AMD	CONFIG_AMDFLASH \
	 INTEL	CONFIG_INTELFLASH" NONE

if [ "$CONFIG_AMDFLASH" = "y" -o "$CONFIG_INTELFLASH" = "y" ]; then
	choice 'FLASH size' \
		" AUTO	CONFIG_FLASHAUTO \
		 128KB	CONFIG_FLASH128KB \
		   1MB	CONFIG_FLASH1MB \
		   2MB	CONFIG_FLASH2MB \
		   4MB	CONFIG_FLASH4MB \
		   6MB	CONFIG_FLASH6MB \
		   8MB	CONFIG_FLASH8MB \
		  16MB	CONFIG_FLASH16MB" AUTO
	choice 'FLASH bit width' \
		" AUTO	CONFIG_FLASHAUTOBIT \
		  8bit	CONFIG_FLASH8BIT \
		 16bit	CONFIG_FLASH16BIT \
		 32bit	CONFIG_FLASH32bit" AUTO
	if [ "$CONFIG_FLASH1MB" = "y" ]; then
		bool '2nd 1MB flash in /dev/rom8' CONFIG_EXTRA_FLASH1MB
	fi
fi

choice 'Kernel executes from' \
	"RAM	CONFIG_RAMKERNEL \
	 ROM	CONFIG_ROMKERNEL \
	 HIMEM  CONFIG_HIMEMKERNEL" ROM

endmenu

#############################################################################

mainmenu_option next_comment
comment 'General setup'

bool 'Networking support' CONFIG_NET
bool 'SGI Visual Workstation support' CONFIG_VISWS
if [ "$CONFIG_VISWS" = "y" ]; then
   define_bool CONFIG_X86_VISWS_APIC y
   define_bool CONFIG_X86_LOCAL_APIC y
   define_bool CONFIG_PCI y
else
   if [ "$CONFIG_SMP" = "y" ]; then
      define_bool CONFIG_X86_IO_APIC y
      define_bool CONFIG_X86_LOCAL_APIC y
   fi
   bool 'PCI support' CONFIG_PCI
   if [ "$CONFIG_PCI" = "y" ]; then
      choice '  PCI access mode' \
	"BIOS		CONFIG_PCI_GOBIOS	\
	 Direct		CONFIG_PCI_GODIRECT	\
	 Any		CONFIG_PCI_GOANY"	Any
      if [ "$CONFIG_PCI_GOBIOS" = "y" -o "$CONFIG_PCI_GOANY" = "y" ]; then
         define_bool CONFIG_PCI_BIOS y
      fi
      if [ "$CONFIG_PCI_GODIRECT" = "y" -o "$CONFIG_PCI_GOANY" = "y" ]; then
         define_bool CONFIG_PCI_DIRECT y
      fi
   fi
fi

source drivers/pci/Config.in

if [ "$CONFIG_VISWS" != "y" ]; then
   bool 'MCA support' CONFIG_MCA
fi

bool 'Support for hot-pluggable devices' CONFIG_HOTPLUG

if [ "$CONFIG_HOTPLUG" = "y" ] ; then
   source drivers/pcmcia/Config.in
else
   define_bool CONFIG_PCMCIA n
fi

bool 'System V IPC' CONFIG_SYSVIPC
bool 'BSD Process Accounting' CONFIG_BSD_PROCESS_ACCT
bool 'Sysctl support' CONFIG_SYSCTL
if [ "$CONFIG_PROC_FS" = "y" ]; then
   choice 'Kernel core (/proc/kcore) format' \
	"ELF		CONFIG_KCORE_ELF	\
	 A.OUT		CONFIG_KCORE_AOUT" ELF
fi
tristate 'Kernel support for flat binaries' CONFIG_BINFMT_FLAT
if [ "$CONFIG_BINFMT_FLAT" != "n" ]; then
   bool '    Enable ZFLAT support' CONFIG_BINFMT_ZFLAT
fi
tristate 'Kernel support for a.out binaries' CONFIG_BINFMT_AOUT
tristate 'Kernel support for ELF binaries' CONFIG_BINFMT_ELF
tristate 'Kernel support for MISC binaries' CONFIG_BINFMT_MISC

bool 'Power Management support' CONFIG_PM

dep_bool '  ACPI support' CONFIG_ACPI $CONFIG_PM
if [ "$CONFIG_ACPI" != "n" ]; then
   if [ "$CONFIG_EXPERIMENTAL" = "y" ]; then
      bool '    ACPI interpreter (EXPERIMENTAL)' CONFIG_ACPI_INTERPRETER
      bool '    Enter S1 for sleep (EXPERIMENTAL)' CONFIG_ACPI_S1_SLEEP
   fi
fi

dep_tristate '  Advanced Power Management BIOS support' CONFIG_APM $CONFIG_PM
if [ "$CONFIG_APM" != "n" ]; then
   bool '    Ignore USER SUSPEND' CONFIG_APM_IGNORE_USER_SUSPEND
   bool '    Enable PM at boot time' CONFIG_APM_DO_ENABLE
   bool '    Make CPU Idle calls when idle' CONFIG_APM_CPU_IDLE
   bool '    Enable console blanking using APM' CONFIG_APM_DISPLAY_BLANK
   bool '    RTC stores time in GMT' CONFIG_APM_RTC_IS_GMT
   bool '    Allow interrupts during APM BIOS calls' CONFIG_APM_ALLOW_INTS
   bool '    Use real mode APM BIOS call to power off' CONFIG_APM_REAL_MODE_POWER_OFF
fi

endmenu

#############################################################################

source drivers/mtd/Config.in

source drivers/parport/Config.in

source drivers/pnp/Config.in

source drivers/block/Config.in

if [ "$CONFIG_NET" = "y" ]; then
   source net/Config.in
fi

source drivers/telephony/Config.in

#############################################################################

mainmenu_option next_comment
comment 'ATA/IDE/MFM/RLL support'

tristate 'ATA/IDE/MFM/RLL support' CONFIG_IDE

if [ "$CONFIG_IDE" != "n" ]; then
  source drivers/ide/Config.in
else
  define_bool CONFIG_BLK_DEV_IDE_MODES n
  define_bool CONFIG_BLK_DEV_HD n
fi
endmenu

#############################################################################

mainmenu_option next_comment
comment 'SCSI support'

tristate 'SCSI support' CONFIG_SCSI

if [ "$CONFIG_SCSI" != "n" ]; then
   source drivers/scsi/Config.in
fi
endmenu

#############################################################################

source drivers/ieee1394/Config.in

source drivers/message/i2o/Config.in

if [ "$CONFIG_NET" = "y" ]; then
   mainmenu_option next_comment
   comment 'Network device support'

   bool 'Network device support' CONFIG_NETDEVICES
   if [ "$CONFIG_NETDEVICES" = "y" ]; then
      source drivers/net/Config.in
      if [ "$CONFIG_ATM" = "y" ]; then
         source drivers/atm/Config.in
      fi
   fi
   endmenu
fi

source net/ax25/Config.in

source net/irda/Config.in

#############################################################################

mainmenu_option next_comment
comment 'ISDN subsystem'
if [ "$CONFIG_NET" != "n" ]; then
   tristate 'ISDN support' CONFIG_ISDN
   if [ "$CONFIG_ISDN" != "n" ]; then
      source drivers/isdn/Config.in
   fi
fi
endmenu

#############################################################################

mainmenu_option next_comment
comment 'Old CD-ROM drivers (not SCSI, not IDE)'

bool 'Support non-SCSI/IDE/ATAPI CDROM drives' CONFIG_CD_NO_IDESCSI
if [ "$CONFIG_CD_NO_IDESCSI" != "n" ]; then
   source drivers/cdrom/Config.in
fi
endmenu

#############################################################################

source drivers/char/Config.in


#source drivers/misc/Config.in

source fs/Config.in

if [ "$CONFIG_VT" = "y" ]; then
   mainmenu_option next_comment
   comment 'Console drivers'
   bool 'VGA text console' CONFIG_VGA_CONSOLE
   bool 'Video mode selection support' CONFIG_VIDEO_SELECT
   if [ "$CONFIG_EXPERIMENTAL" = "y" ]; then
      tristate 'MDA text console (dual-headed) (EXPERIMENTAL)' CONFIG_MDA_CONSOLE
      source drivers/video/Config.in
   fi
   endmenu
fi

#############################################################################

mainmenu_option next_comment
comment 'Sound'

tristate 'Sound card support' CONFIG_SOUND
if [ "$CONFIG_SOUND" != "n" ]; then
   source drivers/sound/Config.in
fi
endmenu

#############################################################################

source drivers/usb/Config.in

#############################################################################

mainmenu_option next_comment
comment 'Kernel hacking'

bool 'Full Symbolic/Source Debugging support' CONFIG_FULLDEBUG
#bool 'Debug kmalloc/kfree' CONFIG_DEBUG_MALLOC
bool 'Magic SysRq key' CONFIG_MAGIC_SYSRQ
if [ "$CONFIG_EXPERIMENTAL" = "y" ]; then
	bool 'Non power-of-2 kernel allocator (EXPERIMENTAL)' CONFIG_CONTIGUOUS_PAGE_ALLOC
	dep_bool '  include /proc/mem_map' CONFIG_MEM_MAP $CONFIG_CONTIGUOUS_PAGE_ALLOC
fi

bool 'Kernel profiling support' CONFIG_PROFILE
if [ "$CONFIG_PROFILE" = "y" ]; then
  int ' Profile shift count' CONFIG_PROFILE_SHIFT 2
  bool 'Use fast second timer for profiling' CONFIG_HIGHPROFILE
fi

if [ "$CONFIG_COLDFIRE" = "y" ]; then
	bool 'Panic/Dump to FLASH' CONFIG_DUMPTOFLASH
fi

bool 'Suppress Kernel BUG Messages' CONFIG_NO_KERNEL_MSG

bool 'Reduce kernel task size to 1 page' CONFIG_SMALL_TASKS

if [ "$CONFIG_EXPERIMENTAL" = "y" -a "$CONFIG_COLDFIRE" = "y" ]; then
    bool 'Disable BDM signals' CONFIG_BDM_DISABLE
fi

endmenu


#############################################################################
```
